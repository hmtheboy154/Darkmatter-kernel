## drivers/misc/ithc/Kconfig
```kconfig
# SPDX-License-Identifier: GPL-2.0-or-later

config MISC_ITHC
	tristate "Intel Touch Host Controller"
	depends on INTEL_MEI
	depends on HID
	help
	  Say Y here if your system has a touchscreen using Intel
	  Touch Host Controller (ITHC) technology.

	  If unsure say N.

	  To compile this driver as a module, choose M here: the
	  module will be called ipts.

	  Building this driver alone will not give you a working touchscreen.
	  It only exposed a userspace API that can be used by a daemon to
	  receive and process data from the touchscreen hardware.
```

## fs/apfs/Kconfig
```kconfig
# SPDX-License-Identifier: GPL-2.0-only
config APFS_FS
	tristate "Apple file system support"
	select LIBCRC32C
	select ZLIB_INFLATE
	select NLS
	select BUFFER_HEAD
	select FS_IOMAP
	select LEGACY_DIRECT_IO
	help
	  If you say Y here, you will be able to mount APFS partitions
	  with read-only access. Write access is experimental and will
	  corrupt your container.
```
